## conf/layer.conf
```bitbake
# We have a conf directory, append to BBPATH
BBPATH .= ":${LAYERDIR}"

# We have a recipes directory, add to BBFILES
BBFILES += "${LAYERDIR}/recipes*/*.bb ${LAYERDIR}/recipes*/*/*.bb"

BBFILE_COLLECTIONS += "meta-gnome-forks"
BBFILE_PATTERN_meta-gnome-forks := "^${LAYERDIR}/"
BBFILE_PRIORITY_meta-gnome-forks = "10"

LAYERDEPENDS_meta-gnome-forks = "core openembedded-layer gnome-layer"
LAYERSERIES_COMPAT_meta-gnome-forks = "gatesgarth honister kirkstone"
```
